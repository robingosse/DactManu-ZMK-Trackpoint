## config/boards/shields/bugbearzmnright/Kconfig.defconfig
```kconfig
if SHIELD_BUGBEARZMNRIGHT

config ZMK_KEYBOARD_NAME
    default "BugBear ZMK Right"

config ZMK_SPLIT_ROLE_CENTRAL
    default y

endif
```

## config/boards/shields/bugbearzmnright/Kconfig.shield
```kconfig
config SHIELD_BUGBEARZMNRIGHT
    def_bool $(shields_list_contains,bugbearzmnright)
```

## config/west.yml
```yaml
manifest:
  remotes:
    - name: zmkfirmware
      url-base: https://github.com/zmkfirmware
    - name: infused-kim
      url-base: https://github.com/infused-kim
    - name: urob
      url-base: https://github.com/urob

  projects:
    # ZMK fork WITH mouse support (this is the critical fix)
    - name: zmk
      remote: urob
      revision: mouse-keys
      import: app/west.yml

    # PS/2 TrackPoint driver
    - name: kb_zmk_ps2_mouse_trackpoint_driver
      remote: infused-kim
      revision: main

  self:
    path: config
```
